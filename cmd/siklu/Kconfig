## cmd/siklu/Kconfig
```kconfig
config SIKLU
	bool "Siklu devices"
	   
config SIKLU_DEFAULT_EXTRA_BOOTARGS
	string "Siklu default extra arguments to kernel line"
	default "console=ttymxc0,115200 nfcConfig=4bitecc board=siklu "

menu "NFS Boot Options"

config SIKLU_DEFAULT_NFS_SERVERIP
	string "Default NFS serverip"
	default "192.168.1.30"
	
config SIKLU_DEFAULT_NFS_NETMASK
	string "Default NFS netmask"
	default "255.255.255.0"
	
config SIKLU_DEFAULT_NFS_ROOTPATH
	string "Default NFS rootpath (%s = developer_id)"
	default "/home/%s/nfs-8010"
	
config SIKLU_NFS_NETDEV
	string "The linux network device that will be used to load nfs, in non-USB mode"
	default "eth0"
	
config SIKLU_NFS_USB_NETDEV
	string "The linux network device that will be used to load nfs, in USB mode"
	default "eth1"
	
config SIKLU_NFS_HOSTNAME
	string "Hostname to be passed to Linux when booting from NFS"
	default "Siklu"
	
config SIKLU_LINUX_NFS_VERSION
	string "Linux NFS version to be used when using nfsroot"
	default "3"

endmenu
```

## cmd/siklu/board/Kconfig
```kconfig
choice
	prompt "Siklu Board selection"

config SIKLU_BOARD_N366
	bool "Siklu TG N366"
	depends on TARGET_MVEBU_ARMADA_8K

config SIKLU_BOARD_TG_TU
	bool "Siklu TG-TU"
	depends on TARGET_TG_TU

endchoice
```

## configs/mx6ull_14x14_skl_defconfig
```kconfig
CONFIG_ARM=y
CONFIG_ARCH_MX6=y
CONFIG_TARGET_MX6ULL_14X14_EVK=y
CONFIG_SIKLU_BOARD=y
CONFIG_DEFAULT_DEVICE_TREE="imx6ull-14x14-skl"
CONFIG_SPI_BOOT=y
CONFIG_SYS_EXTRA_OPTIONS="IMX_CONFIG=board/freescale/mx6ullevk/imximage.cfg"
CONFIG_BOOTDELAY=3
CONFIG_BOARD_EARLY_INIT_F=y
CONFIG_HUSH_PARSER=y
CONFIG_CMD_BOOTZ=y
CONFIG_CMD_MEMTEST=y
CONFIG_NAND=y
CONFIG_BCH=y
CONFIG_NAND_MXS=y
CONFIG_CMD_GPIO=y
CONFIG_CMD_I2C=y
CONFIG_CMD_SPI=y
CONFIG_CMD_NAND=y
CONFIG_CMD_DHCP=y
CONFIG_CMD_PING=y
CONFIG_CMD_CACHE=y
CONFIG_CMD_FS_GENERIC=y
CONFIG_OF_CONTROL=y
CONFIG_ENV_IS_IN_NAND=y
# CONFIG_DM_GPIO is not set
CONFIG_PINCTRL=y
CONFIG_PINCTRL_IMX6=y
CONFIG_DM_REGULATOR=y
CONFIG_MTD_PARTITIONS=y
CONFIG_MTD_DEVICE=y
CONFIG_MTD_PARTITIONS=y
CONFIG_CMD_SF=y
# CONFIG_MMC is not set
```

## configs/tg_tu_defconfig
```kconfig
CONFIG_ARM=y
CONFIG_ARCH_CPU_INIT=y
CONFIG_SYS_THUMB_BUILD=y
CONFIG_ARCH_MVEBU=y
CONFIG_SYS_TEXT_BASE=0x00800000
CONFIG_SPL_GPIO_SUPPORT=y
CONFIG_SPL_LIBCOMMON_SUPPORT=y
CONFIG_SPL_LIBGENERIC_SUPPORT=y
CONFIG_SYS_MALLOC_F_LEN=0x2000
CONFIG_TARGET_TG_TU=y
CONFIG_ENV_SIZE=0x10000
CONFIG_DM_GPIO=y
CONFIG_SPL_SERIAL_SUPPORT=y
CONFIG_SPL_DRIVERS_MISC_SUPPORT=y
CONFIG_NR_DRAM_BANKS=2
CONFIG_SPL=y
CONFIG_DEBUG_UART_BASE=0xd0012000
CONFIG_DEBUG_UART_CLOCK=250000000
CONFIG_SPL_LIBDISK_SUPPORT=y
CONFIG_SPL_SPI_FLASH_SUPPORT=y
CONFIG_SPL_SPI_SUPPORT=y
CONFIG_DEBUG_UART=y
CONFIG_SPL_TEXT_BASE=0x40000030
CONFIG_DISTRO_DEFAULTS=y
CONFIG_BOOTDELAY=3
CONFIG_BOOTCOMMAND="siklu_nand_boot"
CONFIG_USE_PREBOOT=y
CONFIG_SYS_CONSOLE_INFO_QUIET=y
CONFIG_BOARD_LATE_INIT=y
# CONFIG_DISPLAY_BOARDINFO is not set
CONFIG_DISPLAY_BOARDINFO_LATE=y
CONFIG_SYS_MMCSD_RAW_MODE_U_BOOT_DATA_PART_OFFSET=0x1
CONFIG_SPL_I2C_SUPPORT=y
CONFIG_SPL_SPI_LOAD=y
CONFIG_SYS_SPI_U_BOOT_OFFS=0x20000
# CONFIG_CMD_FLASH is not set
CONFIG_CMD_GPIO=y
CONFIG_CMD_I2C=y
CONFIG_CMD_PCI=y
CONFIG_CMD_SPI=y
# CONFIG_CMD_SETEXPR is not set
CONFIG_CMD_CACHE=y
CONFIG_CMD_TIME=y
CONFIG_CMD_MTDPARTS=y
CONFIG_MTDIDS_DEFAULT="nand0=main-storage,nor0=spi1.0"
CONFIG_MTDPARTS_DEFAULT="mtdparts=main-storage:256m(first_bank),-(second_bank);spi1.0:1792k(uboot),64k(uboot_env),64k(device_config),64k(device_mgmt)"
CONFIG_CMD_UBI=y
CONFIG_SIKLU=y
CONFIG_SIKLU_ENV_IS_IN_MTD_NOR=y
CONFIG_SIKLU_ENV_PART="uboot_env"
# CONFIG_SPL_PARTITION_UUIDS is not set
CONFIG_DEFAULT_DEVICE_TREE="armada-385-tg-tu"
# CONFIG_ENV_IS_NOWHERE is not set
CONFIG_NET_RANDOM_ETHADDR=y
CONFIG_REGMAP=y
CONFIG_SPL_OF_TRANSLATE=y
CONFIG_BLK=y
CONFIG_DM_I2C=y
CONFIG_SYS_I2C_MVTWSI=y
CONFIG_I2C_EEPROM=y
CONFIG_SPL_I2C_EEPROM=y
# CONFIG_MMC is not set
CONFIG_MTD=y
CONFIG_MTD_RAW_NAND=y
CONFIG_SYS_NAND_USE_FLASH_BBT=y
CONFIG_NAND_PXA3XX=y
CONFIG_SF_DEFAULT_BUS=1
CONFIG_SPI_FLASH_GIGADEVICE=y
CONFIG_SPI_FLASH_MACRONIX=y
CONFIG_SPI_FLASH_MTD=y
CONFIG_PHY_MARVELL=y
CONFIG_PHY_GIGE=y
CONFIG_MVNETA=y
CONFIG_MII=y
CONFIG_PCI=y
CONFIG_PCI_MVEBU=y
CONFIG_DM_REGULATOR=y
CONFIG_DEBUG_UART_SHIFT=2
CONFIG_SYS_NS16550=y
CONFIG_KIRKWOOD_SPI=y
# CONFIG_EFI_LOADER is not set
```
